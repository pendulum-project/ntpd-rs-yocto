## conf/layer.conf
```bitbake
BBPATH .= ":${LAYERDIR}"

BBFILES += "${LAYERDIR}/recipes-*/*/*.bb \
            ${LAYERDIR}/recipes-*/*/*.bbappend"

BBFILE_COLLECTIONS += "ntpd-rs-yocto"
BBFILE_PATTERN_ntpd-rs-yocto = "^${LAYERDIR}/"
BBFILE_PRIORITY_ntpd-rs-yocto = "6"

LAYERDEPENDS_ntpd-rs-yocto = "core rust-bin-layer"
LAYERSERIES_COMPAT_ntpd-rs-yocto = "blacksail wrynose"
```
